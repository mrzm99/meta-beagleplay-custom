## conf/layer.conf
```bitbake
BBPATH .= ":${LAYERDIR}"
BBFILES += "${LAYERDIR}/recipes-*/*/*.bb \
            ${LAYERDIR}/recipes-*/*/*.bbappend"

BBFILE_COLLECTIONS += "meta-beagleplay-custom"
BBFILE_PATTERN_meta-beagleplay-custom = "^${LAYERDIR}/"
BBFILE_PRIORITY_meta-beagleplay-custom = "6"
LAYERSERIES_COMPAT_meta-beagleplay-custom = "scarthgap"

# for camera app
TOOLCHAIN_TARGET_TASK:append = " gstreamer1.0-dev gstreamer1.0-plugins-base-dev gstreamer1.0-plugins-good-dev glib-2.0-dev"
```
